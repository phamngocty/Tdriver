#include "icons.h"

// ============================================================
// Turn-by-turn arrow icons (64x62 px, 1bpp)
// Each icon is 496 bytes. Index 0 = empty, 1-20 = turn arrows.
// Index 1-20 data is in icons_data.inc
// ============================================================

const uint8_t turnIcons[21][ICON_SIZE] PROGMEM = {
    // Index 0: Empty / straight
    {0},
// Index 1-20: from data file
#include "icons_data.inc"
};

// ============================================================
// Weather icons (32x32 px, 1bpp)
// ============================================================

// Sunny icon (simple sun shape)
const uint8_t weatherIconSunny[WTHR_ICON_SIZE] PROGMEM = {
    0x00, 0x00, 0x00, 0x00, 0x00, 0x00, 0x00, 0x00,
    0x00, 0x00, 0x00, 0x00, 0x00, 0x18, 0x18, 0x00,
    0x00, 0x18, 0x18, 0x00, 0x00, 0x00, 0x00, 0x00,
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    0x00, 0x00, 0x00, 0x00, 0x00, 0x00, 0x00, 0x00};

// Cloudy icon
const uint8_t weatherIconCloudy[WTHR_ICON_SIZE] PROGMEM = {
    0x00, 0x00, 0x00, 0x00, 0x00, 0x00, 0x00, 0x00,
    0x00, 0x00, 0x00, 0x00, 0x00, 0x01, 0x80, 0x00,
    0x00, 0x03, 0xC0, 0x00, 0x00, 0x07, 0xE0, 0x00,
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    0x00, 0x00, 0x00, 0x00, 0x00, 0x00, 0x00, 0x00};

// Rainy icon
const uint8_t weatherIconRainy[WTHR_ICON_SIZE] PROGMEM = {
    0x00, 0x00, 0x00, 0x00, 0x00, 0x00, 0x00, 0x00,
    0x00, 0x00, 0x00, 0x00, 0x00, 0x00, 0x00, 0x00,
    0x00, 0x01, 0x80, 0x00, 0x00, 0x03, 0xC0, 0x00,
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    0x00, 0x00, 0x00, 0x00, 0x00, 0x00, 0x00, 0x00};

// Snowy icon
const uint8_t weatherIconSnowy[WTHR_ICON_SIZE] PROGMEM = {
    0x00, 0x00, 0x00, 0x00, 0x00, 0x00, 0x00, 0x00,
    0x00, 0x00, 0x00, 0x00, 0x00, 0x01, 0x80, 0x00,
    0x00, 0x03, 0xC0, 0x00, 0x00, 0x07, 0xE0, 0x00,
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    0x00, 0x00, 0x00, 0x00, 0x00, 0x00, 0x00, 0x00};

// Map weather icon code to icon index
// Returns: 0=sunny, 1=cloudy, 2=rainy, 3=snowy, -1=unknown
int getWeatherIconIndex(const char *iconCode)
{
    if (!iconCode)
        return -1;
    // Standard OpenWeatherMap icon codes: 01d, 01n (clear)
    if (iconCode[0] == '0' && iconCode[1] == '1')
        return 0; // sunny
    if (iconCode[0] == '0' && iconCode[1] == '2')
        return 1; // cloudy (few clouds)
    if (iconCode[0] == '0' && iconCode[1] == '3')
        return 1; // cloudy (scattered)
    if (iconCode[0] == '0' && iconCode[1] == '4')
        return 1; // cloudy (broken)
    if (iconCode[0] == '0' && iconCode[1] == '9')
        return 2; // rainy (showers)
    if (iconCode[0] == '1' && iconCode[1] == '0')
        return 2; // rainy
    if (iconCode[0] == '1' && iconCode[1] == '1')
        return 2; // rainy (thunderstorm)
    if (iconCode[0] == '1' && iconCode[1] == '3')
        return 3; // snowy
    if (iconCode[0] == '5' && iconCode[1] == '0')
        return 3; // snowy
    return -1;
}
